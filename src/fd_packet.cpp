#include "fd_packet.h"

const uint8_t FD_HELLO[FD_HELLO_LEN] PROGMEM = { 'A', 'T', '+', 'V', 'E', 'R', 'S', 'I', 'O', 'N' };

// Индекс пакета -> адрес первого слова (из ПО Fardriver, «fID to real fID»)
static const uint8_t FD_ADDR_MAP[FD_FRAME_COUNT] PROGMEM = {
    0xE2, 0xE8, 0xEE, 0x00, 0x06, 0x0C, 0x12, 0xE2, 0xE8, 0xEE, 0x18, 0x1E, 0x24, 0x2A,
    0xE2, 0xE8, 0xEE, 0x30, 0x5D, 0x63, 0x69, 0xE2, 0xE8, 0xEE, 0x7C, 0x82, 0x88, 0x8E,
    0xE2, 0xE8, 0xEE, 0x94, 0x9A, 0xA0, 0xA6, 0xE2, 0xE8, 0xEE, 0xAC, 0xB2, 0xB8, 0xBE,
    0xE2, 0xE8, 0xEE, 0xC4, 0xCA, 0xD0, 0xE2, 0xE8, 0xEE, 0xD6, 0xDC, 0xF4, 0xFA
};

// Данные D0…D11 реального контроллера в покое (дамп data/Общение Контроллера ПО.txt).
// Не расшифрованные поля эмулятор отдаёт как есть — драйвер должен их спокойно пропускать.
static const uint8_t FD_TEMPLATE[FD_FRAME_COUNT][12] PROGMEM = {
    { 0x86, 0x0D, 0x00, 0x00, 0x00, 0x00, 0x00, 0x00, 0x00, 0x00, 0xFF, 0xFF },  // 80
    { 0xE0, 0x02, 0xDC, 0x02, 0x00, 0x00, 0x00, 0x00, 0x00, 0x00, 0x00, 0x00 },  // 81
    { 0x00, 0x00, 0x00, 0x00, 0x00, 0x00, 0x00, 0x00, 0x00, 0x00, 0x00, 0x00 },  // 82
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    { 0xF8, 0x07, 0xF7, 0x07, 0x00, 0x40, 0xCB, 0x02, 0x11, 0x22, 0x38, 0x38 },  // B6
};

static inline void le16(uint8_t *p, uint16_t v) { p[0] = (uint8_t)v; p[1] = (uint8_t)(v >> 8); }

uint8_t fdAddrOf(uint8_t idx)
{
    return pgm_read_byte(&FD_ADDR_MAP[idx]);
}

uint16_t fdCrc16(const uint8_t *p, uint8_t len)
{
    uint16_t crc = 0x7F3C;
    for (uint8_t i = 0; i < len; ++i) {
        crc ^= p[i];
        for (uint8_t b = 0; b < 8; ++b)
            crc = (crc & 1) ? (uint16_t)((crc >> 1) ^ 0xA001) : (uint16_t)(crc >> 1);
    }
    return crc;
}

// 24-битное поле фазного тока: ПО считает I = sqrt(x) * 125 / 64, big-endian (D4 — старший)
static void put24(uint8_t *p, float amps)
{
    float s = amps * (64.0f / 125.0f);
    uint32_t x = (uint32_t)(s * s);
    if (x > 0xFFFFFFUL) x = 0xFFFFFFUL;
    p[0] = (uint8_t)(x >> 16); p[1] = (uint8_t)(x >> 8); p[2] = (uint8_t)x;
}

uint8_t fdBuildFrame(uint8_t idx, const MotorModel &m, uint8_t *out)
{
    if (idx >= FD_FRAME_COUNT) idx = 0;
    out[0] = 0xAA;
    out[1] = 0x80 | idx;
    memcpy_P(out + 2, FD_TEMPLATE[idx], 12);
    uint8_t *d = out + 2;

    switch (fdAddrOf(idx)) {
    case FD_ADDR_E2: {
        // D0: б0-1 передача, б2-3 «скорость» (1), б4 вращение против передачи, б5 движется,
        //     б6 WEAK (ослабление поля), б7 — всегда 1 в дампах (смысл неизвестен)
        d[0] = (uint8_t)((m.gear & 3) | ((CFG_SPEED_LEVEL & 3) << 2) | (m.against ? 0x10 : 0) |
                         (m.moving ? 0x20 : 0) | (m.weak ? 0x40 : 0) | 0x80);
        // D1: б0-2 датчики Холла, б3 — 1 в дампах («Pass Error» в ПО, если 0)
        d[1] = (uint8_t)((m.hall & 7) | 0x08);
        le16(d + 2, m.errors);
        le16(d + 4, m.mod_x128);
        le16(d + 6, (uint16_t)(m.rpm * CFG_RPM_RAW_PER_RPM));
        le16(d + 8, (uint16_t)m.id_x16);
        le16(d + 10, (uint16_t)m.iq_x16);
        break;
    }
    case FD_ADDR_E8:
        le16(d + 0, m.v_x10);
        le16(d + 2, m.v2_x10);
        le16(d + 4, (uint16_t)m.idc_x4);
        le16(d + 6, (uint16_t)m.iqref_x16);
        le16(d + 8, (uint16_t)m.idref_x16);
        le16(d + 10, (uint16_t)m.throttle_raw);
        break;
    case FD_ADDR_EE:
        memset(d, 0, 12);
        put24(d + 4, m.iph_a);
        put24(d + 7, m.iph2_a);
        break;
    case FD_ADDR_B3: {
        uint16_t w1 = (uint16_t)(d[2] | ((uint16_t)d[3] << 8)) & 0xF7FF;   // б11: 0 — «КЗ фазы»
        uint16_t w2 = (uint16_t)(d[4] | ((uint16_t)d[5] << 8)) & 0x7FFF;
        if (m.ov_flag) w2 |= 0x8000;                                // 1 — «Over Voltage»
        le16(d + 2, w1);
        le16(d + 4, w2);
        le16(d + 10, (uint16_t)m.t_ctrl);
        break;
    }
    case FD_ADDR_F4:
        le16(d + 0, (uint16_t)m.t_motor);
        le16(d + 8, m.noise16);
        break;
    case FD_ADDR_FA:
        le16(d + 0, m.adc_ofs_a);
        le16(d + 2, m.adc_ofs_b);
        break;
    case FD_ADDR_ODO_LO:
        le16(d + 8, (uint16_t)(m.odo_01km & 0xFFFF));
        break;
    case FD_ADDR_ODO_HI:
        le16(d + 10, (uint16_t)(m.odo_01km >> 16));
        break;
    }

    uint16_t crc = fdCrc16(out, 14);
    out[14] = (uint8_t)crc;
    out[15] = (uint8_t)(crc >> 8);
    return FD_FRAME_LEN;
}

int16_t fdParseCommand(const uint8_t *p)
{
    if (p[0] != 0xAA) return -1;
    if ((uint8_t)~p[1] != p[2]) return -1;
    uint8_t s = 0;
    for (uint8_t i = 0; i < 6; ++i) s += p[i];
    if (p[6] != s || (uint8_t)~s != p[7]) return -1;
    return p[1];
}
